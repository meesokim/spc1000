//
// SpectrumScreen.cpp
//
// Spectrum screen emulator code provided by Jose Luis Sanchez
//
// This program is free software: you can redistribute it and/or modify
// it under the terms of the GNU General Public License as published by
// the Free Software Foundation, either version 3 of the License, or
// (at your option) any later version.
//
// This program is distributed in the hope that it will be useful,
// but WITHOUT ANY WARRANTY; without even the implied warranty of
// MERCHANTABILITY or FITNESS FOR A PARTICULAR PURPOSE.  See the
// GNU General Public License for more details.
//
// You should have received a copy of the GNU General Public License
// along with this program.  If not, see <http://www.gnu.org/licenses/>.
//
#include "mc6847.h"
#include <assert.h>
#include <string.h>
#include <stdio.h>


CMC6847::CMC6847 (void)
:	m_pBuffer (0)
{
	GMODE = 0;
}

CMC6847::~CMC6847 (void)
{
	delete m_pBuffer;
}

// really ((green) & 0x3F) << 5, but to have a 0-31 range for all colors
#define COLOR16(red, green, blue)	  (((red>>3) & 0x1F) << 11 \
					| ((green>>2) & 0x3F) << 6 \
					| ((blue>>3) & 0x1F))

// BGRA (was RGBA with older firmware)
#define COLOR32(red, green, blue, alpha)  (((red) & 0xFF)       \
					| ((green) & 0xFF) << 8  \
					| ((blue) & 0xFF)   << 16 \
					| ((alpha) & 0xFF) << 24)

#define SCREEN_HEIGHT 240
#define SCREEN_WIDTH 320
#define VDP_HEIGHT 192
#define VDP_WIDTH 256
#define _BIT(a, b) (a & (1 << b))
#define SCREEN_TEXT_START 0
#define SCREEN_ATTR_START 0x800
#define FILL(a,d,c) pos=d;while(pos-->0)*a++=palette[c]
#define REPT (SCREEN_HEIGHT - VDP_HEIGHT)/2 * SCREEN_WIDTH
#define REPL (SCREEN_WIDTH - VDP_WIDTH)/2
#define REPR (SCREEN_WIDTH - VDP_WIDTH)/2
#define REPB (SCREEN_HEIGHT - VDP_HEIGHT)/2 * SCREEN_WIDTH
typedef unsigned char PIXEL;

bool CMC6847::Initialize ()
{
	memset(VRAM, 0, sizeof(VRAM));
	GMODE = 0;
	m_pBuffer = new u16[SCREEN_HEIGHT * SCREEN_WIDTH];
	assert (m_pBuffer != 0);

	// Color palette definition, uses RGB565 format
	// Needs to be defined BEFORE call Initialize

	palette[0]    = COLOR16(0x00, 0x00, 0x00);  // black
	palette[1]    = COLOR16(0x07, 0xff, 0x00);  // green
	palette[2]    = COLOR16(0xff, 0xff, 0x00);  // yellow
	palette[3]    = COLOR16(0x3b, 0x08, 0xff);  // blue
	palette[4]    = COLOR16(0xcc, 0x00, 0x3b);  // red

	palette[5]    = COLOR16(0xff, 0xff, 0xff);  // buff
	palette[6]    = COLOR16(0x07, 0xe3, 0x99);  // cyan
	palette[7]    = COLOR16(0xff, 0x1c, 0xff);  // magenta
	palette[8]    = COLOR16(0xff, 0x81, 0x00);  // orange
	palette[9]    = COLOR16(0x07, 0xff, 0x00);  // green

	palette[10]   = COLOR16(0xff, 0xff, 0xff); // buff

	palette[11]   = COLOR16(0x00, 0x3f, 0x00); // dark green
	palette[12]   = COLOR16(0x07, 0xff, 0x00); // bright green
	palette[13]   = COLOR16(0x91, 0x00, 0x00); // dark orange
	palette[14]   = COLOR16(0xff, 0x81, 0x00); // bright orange
	palette[0xff] = COLOR16(0xff, 0xff, 0xff);
	palette[0x46] = COLOR16(0xff, 0x00, 0x00); 

	// memset(m_pVideoMem, 0x0, SCREEN_HEIGHT * SCREEN_WIDTH);

    int i, j;
	for (i = 0; i < 18; i++)
		cMap[i] = i;
	for (i = 0; i < 16; i++)
    {
		for(j = 0; j < 12; j++)
		{
			unsigned char val = 0;
			if (j < 6)
			{
				if (i & 0x08) val |= 0xf0;
				if (i & 0x04) val |= 0x0f;
			}
			else
			{
				if (i & 0x02) val |= 0xf0;
				if (i & 0x01) val |= 0x0f;
			}
			semiGrFont0[i*12+j] = val;
		}
    }
	for (i = 0; i < 64; i++)
    {
		for(j = 0; j < 12; j++)
		{
			unsigned char val = 0;
			if (j < 4)
			{
				if (i & 0x20) val |= 0xf0;
				if (i & 0x10) val |= 0x0f;
			}
			else if (j < 8)
			{
				if (i & 0x08) val |= 0xf0;
				if (i & 0x04) val |= 0x0f;
			}
			else
			{
				if (i & 0x02) val |= 0xf0;
				if (i & 0x01) val |= 0x0f;
			}
			semiGrFont1[i*12+j] = val;
		}
    }
	return true;
}

void CMC6847::Update ()
{
	assert (m_pBuffer != 0);

	int pos = 0;
	u8 gmode = GMODE;
	u16 *data = (u16 *)m_pBuffer;
	u8 _gm0, _gm1, _ag, _css;
	u16 _page, y, h, x, mask;
	u8 attr, ch, b, cix, c;
	_gm0 = _BIT(gmode, 2);
	_gm1 = _BIT(gmode, 1);
	//int _gm2 = 1;
	_ag = _BIT(gmode, 3);
	_css = _BIT(gmode, 7);
	_page = gmode >> 4 & 0x3;
	PIXEL bg, fg, border;
	border = cMap[0];
	b = 0;
	if (_ag == 0)
    {
		FILL(data, REPT, border);
		for(y=0; y < 16; y++)
		{
			for(h=0; h < 12; h++)
			{
			FILL(data, REPL, border);
			for(x=0; x < 32; x++)
			{
				attr = VRAM[x + y * 32 + SCREEN_ATTR_START + _page * 0x200];
				ch = VRAM[x + y * 32 + SCREEN_TEXT_START + _page * 0x200];
				if ((attr & ATTR_SEM) != 0)
				{
					bg = cMap[0];
					if ((attr & ATTR_EXT) != 0)
					{
						fg = cMap[(((attr & ATTR_CSS) << 1) | ((ch & 0xc0) >> 6)) + 1];
						b = semiGrFont1[(ch & 0x3f) * 12 + h];	
					} 
					else 
					{
						fg = cMap[((ch & 0x70)>> 4) + 1];
						//printf("fg=%d,%d\n", ch, ((ch & 0x70)>> 4) + 1);
						b = semiGrFont0[(ch & 0x0f) * 12 + h];
					}
				}
				else // ASCII
				{
					cix = (attr & ATTR_CSS) >> 1; 
					if ((attr & ATTR_INV) == 0)
					{
						bg = cMap[11 + cix * 2];
						fg = cMap[11 + cix * 2 + 1];
					}
					else
					{
						fg = cMap[11 + cix * 2];
						bg = cMap[11 + cix * 2 + 1];
					}
					if (ch < 32 && ((attr & ATTR_EXT) == 0))
						ch = 32;	
					if (((attr & ATTR_EXT) != 0) && (ch < 96))
						ch += 128;
					if (ch >= 96 && ch < 128)
						b = VRAM[0x1600+(ch-96)*16+h];
					else if (ch >= 128 && ch < 224)
						b = VRAM[0x1000+(ch-128)*16+h];
					else if (ch >= 32)
						b = CGROM[(ch-32)*12+h];
				}
				for(mask = 0x80; mask != 0; mask >>=1)
				{
					*data++ = palette[(((b & mask) != 0) ? fg : bg)];
				}
			}
			FILL(data, REPR, border);
			}
		}
		FILL(data, REPB, border);
    }
    else
    {
		bg = cMap[0];
		border = fg = (_css ? cMap[10] : cMap[9]);
		//border = (_css ? cMap[10] : cMap[9]);
		FILL(data, REPT, border);
		for(y = 0; y < 192; y++)
		{
			FILL(data, REPL, border);
			for(x = 0; x < 32; x++)
			{
				b = VRAM[y * 32 + x];
				if (_gm1)
				{
					if (_gm0)
					{ 
						for(mask = 0x80; mask != 0; mask >>=1)
						{	
							*data++ = palette[(b & mask) != 0 ? fg : bg];
						}
					}
					else // _gm0 == 0
					{
						for(c = 6; c < 8 && c >= 0; c-=2)
						{
							*data++ = palette[cMap[((b & (0x3 << c)) >> c) + (_css ? 5 : 1)]];
							*data++ = palette[cMap[((b & (0x3 << c)) >> c) + (_css ? 5 : 1)]];
						}
					}
				}
				else
				{
					if (_gm0)
					{
						for(mask = 0x80; mask != 0; mask >>=1)
						{	
							*data++ = palette[(b & mask) != 0 ? fg : bg];
							*data++ = palette[(b & mask) != 0 ? fg : bg];
						}
					}
					else
					{
						for(c = 6; c > 0; c-=2)
						{
							*(data + 256 + 1) = *(data + 256) = *(data+1) = *data = palette[cMap[((b & (0x3 << c)) >> c) + (_css ? 5 : 1)]];
							data+=2;
						}
					}
				} 
			}
			FILL(data, REPR, border);
	    }
      	FILL(data, REPB, border);
    }
}

u16 * CMC6847::GetBuffer() {
	return m_pBuffer;
}

/**
 * MC6847 Character Generator Internal ROM Data. (provided by Zanny)
 */
unsigned char CMC6847::CGROM[] =
{
 0x00, 0x00, 0x00, 0x00, 0x00, 0x00, 0x00, 0x00, 0x00, 0x00, 0x00, 0x00, //32
 0x00, 0x00, 0x00, 0x08, 0x08, 0x08, 0x08, 0x08, 0x00, 0x08, 0x00, 0x00,
 0x00, 0x00, 0x00, 0x14, 0x14, 0x14, 0x00, 0x00, 0x00, 0x00, 0x00, 0x00,
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 0xFF, 0xFF, 0xFF, 0xFF, 0xFF, 0xFF, 0xFF, 0xFF, 0xFF, 0xFF, 0xFF, 0xFF
};

