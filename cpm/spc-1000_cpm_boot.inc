SDINIT  	EQU 00000H
SDWRITE 	EQU 00001H
SDREAD  	EQU 00002H
SDSEND  	EQU 00003H
SDCOPY  	EQU 00004H
SDFORMAT	EQU 00005H
SDSTATUS	EQU 00006H
SDDRVSTS	EQU 00007H
SDRAMTST	EQU 00008H
SDTRANS2	EQU 00009H
SDNOACT 	EQU 0000AH
SDTRANS1	EQU 0000BH
SDRCVE  	EQU 0000CH
SDGO    	EQU 0000DH
SDLOAD  	EQU 0000EH
SDSAVE  	EQU 0000FH
SDLDNGO 	EQU 00010H
SECTS   	EQU 00032H
MSIZE   	EQU 0003AH
BIOSL   	EQU 00300H
CLR2    	EQU 00AD5H
SIZE    	EQU 01900H
CLS     	EQU 01B42H
BIAS    	EQU 09800H
CPM_RUN 	EQU 0CB00H
LOADCPM 	EQU 0CB0AH
LOAD    	EQU 0CB32H
LOAD1   	EQU 0CB48H
SYM1    	EQU 0CB6BH
SENDCOM 	EQU 0CB78H
SENDDAT 	EQU 0CB80H
CHKRFD1 	EQU 0CB84H
CHKDAC2 	EQU 0CB9BH
CHKDAC3 	EQU 0CBA8H
GETDATA 	EQU 0CBAFH
CHKDAV0 	EQU 0CBBCH
CHKDAV1 	EQU 0CBD3H
CCP     	EQU 0CC00H
BOOT    	EQU 0E200H
BIOS    	EQU 0E200H
DSKIX   	EQU 0F9DFH
