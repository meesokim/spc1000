VRAM    	EQU 00000H
SDINIT  	EQU 00000H
CONSTA  	EQU 00000H
CONDAT  	EQU 00001H
SDWRITE 	EQU 00001H
PRTSTA  	EQU 00002H
SDREAD  	EQU 00002H
PRTDAT  	EQU 00003H
SDSEND  	EQU 00003H
IOBYTE  	EQU 00003H
SDCOPY  	EQU 00004H
CDISK   	EQU 00004H
SDFORMAT	EQU 00005H
AUXDAT  	EQU 00005H
SDSTATUS	EQU 00006H
SDDRVSTS	EQU 00007H
SDRAMTST	EQU 00008H
FUNS    	EQU 00008H
SDTRANS2	EQU 00009H
FDCD    	EQU 0000AH
SDNOACT 	EQU 0000AH
SDTRANS1	EQU 0000BH
FDCT    	EQU 0000BH
SDRCVE  	EQU 0000CH
FDCS    	EQU 0000CH
SDGO    	EQU 0000DH
FDCOP   	EQU 0000DH
FDCST   	EQU 0000EH
SDLOAD  	EQU 0000EH
SDSAVE  	EQU 0000FH
DMAL    	EQU 0000FH
SDLDNGO 	EQU 00010H
DMAH    	EQU 00010H
NSECTS  	EQU 0002CH
MSIZE   	EQU 0003AH
DATSIZ  	EQU 00A9AH
KEYBUF  	EQU 07A4FH
BIAS    	EQU 09800H
CCP     	EQU 0CC00H
BDOS    	EQU 0D406H
BIOS    	EQU 0E200H
WBOOTE  	EQU 0E203H
DPBASE  	EQU 0E233H
TRANS   	EQU 0E253H
DPBLK   	EQU 0E26DH
SIGNON  	EQU 0E27CH
LDERR   	EQU 0E2AFH
PRTMSG  	EQU 0E2C5H
BOOT    	EQU 0E2D0H
CLS3    	EQU 0E2E1H
WBOOT   	EQU 0E2F9H
LOAD1   	EQU 0E30DH
LOAD2   	EQU 0E328H
GOCPM   	EQU 0E343H
CONST   	EQU 0E364H
CONIN   	EQU 0E36CH
CONOUT  	EQU 0E370H
ASCPRT  	EQU 0E371H
LIST    	EQU 0E377H
LISTST  	EQU 0E379H
PUNCHS  	EQU 0E37CH
READER  	EQU 0E37EH
HOME    	EQU 0E37FH
SELDSK  	EQU 0E384H
SELFD   	EQU 0E38DH
SELFD$  	EQU 0E399H
SETTRK  	EQU 0E3A8H
SETSEC  	EQU 0E3B7H
SETSEC0 	EQU 0E3CAH
SECTRAN 	EQU 0E3CFH
SECT1   	EQU 0E3DAH
SETDMA  	EQU 0E3E0H
READ    	EQU 0E3E5H
BUFCHECK	EQU 0E3ECH
REALREAD	EQU 0E3F2H
SYM1    	EQU 0E41DH
BUFCOPY 	EQU 0E427H
ODDREAD 	EQU 0E42FH
EVENREAD	EQU 0E430H
WRITE   	EQU 0E43BH
WRITEC  	EQU 0E43BH
ODDWRIT 	EQU 0E448H
EVENWRIT	EQU 0E449H
CHKWCPY 	EQU 0E450H
CHKWFLG 	EQU 0E450H
WRITEM  	EQU 0E450H
READ1   	EQU 0E47DH
WAITIO  	EQU 0E4A5H
SENDCOM 	EQU 0E4A6H
SENDDAT 	EQU 0E4AEH
CHKRFD1 	EQU 0E4B2H
CHKDAC2 	EQU 0E4C9H
CHKDAC3 	EQU 0E4D6H
GETDATA 	EQU 0E4DDH
CHKDAV0 	EQU 0E4E8H
CHKDAV1 	EQU 0E4FFH
FDD#N   	EQU 0E50CH
FDD#D   	EQU 0E50DH
FDD#T   	EQU 0E50EH
FDD#S   	EQU 0E50FH
DATADDR 	EQU 0E510H
CHGFLG  	EQU 0E512H
PRESEC  	EQU 0E513H
BRKEY   	EQU 0E514H
ASCGET1 	EQU 0E51BH
BUFCEK  	EQU 0E525H
GETRET  	EQU 0E533H
BUFSET  	EQU 0E537H
FLASHF  	EQU 0E538H
BRKGTR  	EQU 0E544H
KEYGT   	EQU 0E54BH
ZERORT  	EQU 0E55AH
ZEROR2  	EQU 0E55DH
FLGET   	EQU 0E560H
REPETS  	EQU 0E570H
KEYBFA  	EQU 0E574H
KEYBFD  	EQU 0E577H
NEWKYS  	EQU 0E57EH
REPTSW  	EQU 0E582H
KEYST2  	EQU 0E584H
SETLP1  	EQU 0E58EH
SETPL2  	EQU 0E595H
SETPL3  	EQU 0E59EH
SETPL4  	EQU 0E5A2H
KYBFSR  	EQU 0E5A6H
FLASHS  	EQU 0E5B1H
FLASHG  	EQU 0E5B2H
FLASHA  	EQU 0E5B3H
FLASHD  	EQU 0E5B6H
FLASHC  	EQU 0E5B7H
L0D28   	EQU 0E5C0H
FLASHO  	EQU 0E5C2H
FLASHE  	EQU 0E5C5H
FLSHGT  	EQU 0E5CDH
FLGTLP  	EQU 0E5D3H
REPETF  	EQU 0E5E8H
FLSHL3  	EQU 0E5F6H
FLGTL2  	EQU 0E5F9H
FLSHRT  	EQU 0E602H
KEYSEN  	EQU 0E60BH
KEYSN0  	EQU 0E60EH
KEYSN1  	EQU 0E610H
KEYSN2  	EQU 0E61DH
KEYSN3  	EQU 0E627H
L0D9D   	EQU 0E62EH
L0DA5   	EQU 0E636H
L0DB1   	EQU 0E642H
L0DB9   	EQU 0E64AH
NEWCEK  	EQU 0E64CH
NEWPL1  	EQU 0E654H
SAMECK  	EQU 0E662H
SAMELP  	EQU 0E66AH
NEWFLG  	EQU 0E672H
FLGLP1  	EQU 0E67AH
FLGLP2  	EQU 0E690H
FLGLP4  	EQU 0E69DH
FLGLP3  	EQU 0E69FH
FLGLP5  	EQU 0E6A4H
FLGLP6  	EQU 0E6A8H
FLGLP9  	EQU 0E6B2H
FLGLP7  	EQU 0E6B6H
FLGLP8  	EQU 0E6BDH
KYBFST  	EQU 0E6C6H
L0E4C   	EQU 0E6DDH
CTRLNO  	EQU 0E6EDH
SETKY   	EQU 0E6FAH
NONKEY  	EQU 0E6FDH
NONKE?  	EQU 0E700H
SETKY2  	EQU 0E708H
FUNCTN  	EQU 0E723H
FUNCLP  	EQU 0E735H
BFSTSB  	EQU 0E73EH
NONSET  	EQU 0E757H
NORET   	EQU 0E759H
CTL     	EQU 0E75AH
NOINC1  	EQU 0E763H
JPHL    	EQU 0E767H
CTLTBL  	EQU 0E768H
ACCPRT1 	EQU 0E7A8H
CTLLF   	EQU 0E7BAH
LOWEST  	EQU 0E7D7H
MOVEN1  	EQU 0E7E4H
MOVEN2  	EQU 0E7F3H
SETAD   	EQU 0E7FBH
CTLCR   	EQU 0E814H
CTLUP   	EQU 0E81AH
CTLRHT  	EQU 0E823H
RHTOK   	EQU 0E837H
CTLLFT  	EQU 0E83AH
LFTOK   	EQU 0E84AH
CTLHOM  	EQU 0E84EH
CTLCLS  	EQU 0E856H
LOOP1   	EQU 0E868H
CTLESC  	EQU 0E871H
CTLNUL  	EQU 0E876H
ESC     	EQU 0E877H
ESC3    	EQU 0E87DH
XOK     	EQU 0E88DH
YOK     	EQU 0E89AH
ESC2    	EQU 0E8A0H
ESC1    	EQU 0E8AAH
ESCEQ   	EQU 0E8BFH
ESCT    	EQU 0E8C5H
ESCTLP  	EQU 0E8D3H
ESCY    	EQU 0E8DBH
ESCYLP  	EQU 0E8DFH
CALCAD  	EQU 0E8F3H
COPYCHR 	EQU 0E902H
XEVEN   	EQU 0E921H
XODD    	EQU 0E94EH
INCCSR  	EQU 0E979H
FONT    	EQU 0E989H
CAPS    	EQU 0EB09H
ESCMOD  	EQU 0EB0AH
ESCEQY  	EQU 0EB0BH
TIME    	EQU 0EB0CH
CSRX    	EQU 0EB0DH
CSRY    	EQU 0EB0EH
CSRAD   	EQU 0EB0FH
CSRATT  	EQU 0EB11H
CSROUT  	EQU 0EB13H
WIDTH   	EQU 0EB14H
HEIGHT  	EQU 0EB15H
VDAREA  	EQU 0EB17H
GMODEF  	EQU 0EB18H
CURX    	EQU 0EB19H
CURY    	EQU 0EB1AH
OLDBUF  	EQU 0EB1BH
NEWBUF  	EQU 0EB25H
NEWMOD  	EQU 0EB2EH
LOCKMD  	EQU 0EB2FH
POINT1  	EQU 0EB30H
POINT2  	EQU 0EB31H
FUNBUF  	EQU 0EB32H
KEYDT1  	EQU 0EB83H
KEYDT2  	EQU 0EBCBH
DIRBF   	EQU 0EC13H
BEGDAT  	EQU 0EC13H
ALL00   	EQU 0EC93H
ALL01   	EQU 0ECB2H
ALL02   	EQU 0ECD1H
ALL03   	EQU 0ECF0H
ALLHD1  	EQU 0ED0FH
ALLHD2  	EQU 0EE0EH
CHK00   	EQU 0EF0DH
CHK01   	EQU 0EF1DH
CHK02   	EQU 0EF2DH
CHK03   	EQU 0EF3DH
CHKHD2  	EQU 0EF4DH
INKYBF  	EQU 0EF4DH
CHKHD1  	EQU 0EF4DH
TABBUF  	EQU 0EF8DH
VDISP   	EQU 0EFADH
DISKDATA	EQU 0F5ADH
ENDDAT  	EQU 0F6ADH
