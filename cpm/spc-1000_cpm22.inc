IOBYTE  	EQU 00003H
CNTRLC  	EQU 00003H
TDRIVE  	EQU 00004H
CNTRLE  	EQU 00005H
ENTRY   	EQU 00005H
NUMCMDS 	EQU 00006H
BS      	EQU 00008H
TAB     	EQU 00009H
LF      	EQU 0000AH
FF      	EQU 0000CH
CR      	EQU 0000DH
CNTRLP  	EQU 00010H
CNTRLR  	EQU 00012H
CNTRLS  	EQU 00013H
CNTRLU  	EQU 00015H
CNTRLX  	EQU 00018H
CNTRLZ  	EQU 0001AH
NFUNCTS 	EQU 00029H
MEM     	EQU 0003AH
TFCB    	EQU 0005CH
DEL     	EQU 0007FH
TBUFF   	EQU 00080H
TBASE   	EQU 00100H
CBASE   	EQU 0CC00H
INBUFF  	EQU 0CC06H
INPOINT 	EQU 0CC88H
NAMEPNT 	EQU 0CC8AH
PRINT   	EQU 0CC8CH
PRINTB  	EQU 0CC92H
CRLF    	EQU 0CC98H
SPACE   	EQU 0CCA2H
PLINE   	EQU 0CCA7H
PLINE2  	EQU 0CCACH
RESDSK  	EQU 0CCB8H
DSKSEL  	EQU 0CCBDH
ENTRY1  	EQU 0CCC3H
OPEN    	EQU 0CCCBH
OPENFCB 	EQU 0CCD0H
CLOSE   	EQU 0CCDAH
SRCHFST 	EQU 0CCDFH
SRCHNXT 	EQU 0CCE4H
SRCHFCB 	EQU 0CCE9H
DELETE  	EQU 0CCEFH
ENTRY2  	EQU 0CCF4H
RDREC   	EQU 0CCF9H
READFCB 	EQU 0CCFEH
WRTREC  	EQU 0CD04H
CREATE  	EQU 0CD09H
RENAM   	EQU 0CD0EH
GETUSR  	EQU 0CD13H
GETSETUC	EQU 0CD15H
SETCDRV 	EQU 0CD1AH
MOVECD  	EQU 0CD29H
UPPER   	EQU 0CD30H
GETINP  	EQU 0CD39H
GETINP1 	EQU 0CD96H
GETINP2 	EQU 0CDA7H
GETINP3 	EQU 0CDABH
GETINP4 	EQU 0CDBAH
CHKCON  	EQU 0CDC2H
GETDSK  	EQU 0CDD0H
STDDMA  	EQU 0CDD5H
DMASET  	EQU 0CDD8H
DELBATCH	EQU 0CDDDH
VERIFY  	EQU 0CDF5H
VERIFY1 	EQU 0CDFDH
SYNERR  	EQU 0CE09H
SYNERR1 	EQU 0CE0FH
SYNERR2 	EQU 0CE22H
CHECK   	EQU 0CE30H
NONBLANK	EQU 0CE4FH
ADDHL   	EQU 0CE59H
CONVFST 	EQU 0CE5EH
CONVERT 	EQU 0CE60H
CONVRT1 	EQU 0CE89H
CONVRT2 	EQU 0CE90H
CONVRT3 	EQU 0CE96H
CONVRT4 	EQU 0CE98H
CONVRT5 	EQU 0CEA9H
CONVRT6 	EQU 0CEABH
CONVRT7 	EQU 0CEAFH
CONVRT8 	EQU 0CEB9H
GETEXT  	EQU 0CEC0H
GETEXT1 	EQU 0CEC8H
GETEXT2 	EQU 0CED9H
GETEXT3 	EQU 0CEDBH
GETEXT4 	EQU 0CEDFH
GETEXT5 	EQU 0CEE9H
GETEXT6 	EQU 0CEF0H
GETEXT7 	EQU 0CEF2H
GETEXT8 	EQU 0CF01H
GETEXT9 	EQU 0CF09H
CMDTBL  	EQU 0CF10H
PATTRN1 	EQU 0CF28H
SEARCH  	EQU 0CF2EH
SEARCH1 	EQU 0CF33H
SEARCH2 	EQU 0CF3CH
SEARCH3 	EQU 0CF4FH
SEARCH4 	EQU 0CF54H
CLEARBUF	EQU 0CF58H
COMMAND 	EQU 0CF5CH
CMMND1  	EQU 0CF82H
CMMND2  	EQU 0CF98H
CMDADR  	EQU 0CFC1H
HALT    	EQU 0CFCFH
RDERROR 	EQU 0CFD9H
RDERR   	EQU 0CFDFH
NONE    	EQU 0CFEAH
NOFILE  	EQU 0CFF0H
DECODE  	EQU 0CFF8H
DECODE1 	EQU 0D008H
DECODE2 	EQU 0D02AH
DECODE3 	EQU 0D033H
DECODE4 	EQU 0D03AH
MOVE3   	EQU 0D040H
HL2DE   	EQU 0D042H
EXTRACT 	EQU 0D04BH
DSELECT 	EQU 0D054H
RESETDR 	EQU 0D066H
DIRECT  	EQU 0D077H
DIRECT1 	EQU 0D088H
DIRECT2 	EQU 0D08FH
DIRECT3 	EQU 0D098H
DIRECT4 	EQU 0D0CCH
DIRECT5 	EQU 0D0D4H
DIRECT6 	EQU 0D0D9H
DRECT63 	EQU 0D0F7H
DRECT65 	EQU 0D0F9H
DIRECT7 	EQU 0D10EH
DIRECT8 	EQU 0D10FH
DIRECT9 	EQU 0D11BH
ERASE   	EQU 0D11FH
ERASE1  	EQU 0D142H
YESNO   	EQU 0D152H
TYPE    	EQU 0D15DH
TYPE1   	EQU 0D174H
TYPE2   	EQU 0D177H
TYPE3   	EQU 0D187H
TYPE4   	EQU 0D1A0H
TYPE5   	EQU 0D1A7H
SAVE    	EQU 0D1ADH
SAVE1   	EQU 0D1D4H
SAVE2   	EQU 0D1F1H
SAVE3   	EQU 0D1FBH
SAVE4   	EQU 0D201H
NOSPACE 	EQU 0D207H
RENAME  	EQU 0D210H
RENAME1 	EQU 0D23FH
RENAME2 	EQU 0D259H
RENAME3 	EQU 0D25EH
RENAME4 	EQU 0D26DH
RENAME5 	EQU 0D273H
RENAME6 	EQU 0D279H
EXISTS  	EQU 0D282H
USER    	EQU 0D28EH
UNKNOWN 	EQU 0D2A5H
UNKWN1  	EQU 0D2C4H
UNKWN2  	EQU 0D2CDH
UNKWN3  	EQU 0D2E1H
UNKWN4  	EQU 0D301H
UNKWN5  	EQU 0D330H
UNKWN6  	EQU 0D33EH
UNKWN7  	EQU 0D343H
UNKWN8  	EQU 0D34FH
UNKWN9  	EQU 0D36BH
UNKWN0  	EQU 0D371H
BADLOAD 	EQU 0D37AH
COMFILE 	EQU 0D383H
GETBACK 	EQU 0D386H
GETBACK1	EQU 0D389H
BATCH   	EQU 0D3ABH
CCPSTACK	EQU 0D3ABH
BATCHFCB	EQU 0D3ACH
FCB     	EQU 0D3CDH
RTNCODE 	EQU 0D3EEH
CDRIVE  	EQU 0D3EFH
CHGDRV  	EQU 0D3F0H
NBYTES  	EQU 0D3F1H
PATTRN2 	EQU 0D400H
FBASE   	EQU 0D406H
BADSCTR 	EQU 0D409H
BADSLCT 	EQU 0D40BH
RODISK  	EQU 0D40DH
ROFILE  	EQU 0D40FH
FBASE1  	EQU 0D411H
FUNCTNS 	EQU 0D447H
ERROR1  	EQU 0D499H
ERROR2  	EQU 0D4A5H
ERROR3  	EQU 0D4ABH
ERROR4  	EQU 0D4B1H
ERROR5  	EQU 0D4B4H
BDOSERR 	EQU 0D4BAH
BDOSDRV 	EQU 0D4C6H
BADSEC  	EQU 0D4CAH
BADSEL  	EQU 0D4D5H
FILERO  	EQU 0D4DCH
DISKRO  	EQU 0D4E1H
PRTERR  	EQU 0D4E5H
GETCHAR 	EQU 0D4FBH
GETECHO 	EQU 0D506H
CHKCHAR 	EQU 0D514H
CKCONSOL	EQU 0D523H
CKCON1  	EQU 0D542H
CKCON2  	EQU 0D545H
OUTCHAR 	EQU 0D548H
OUTCHR1 	EQU 0D562H
OUTCHR2 	EQU 0D579H
SHOWIT  	EQU 0D57FH
OUTCON  	EQU 0D590H
OUTCON1 	EQU 0D596H
BACKUP  	EQU 0D5A4H
BACKUP1 	EQU 0D5ACH
NEWLINE 	EQU 0D5B1H
NEWLN1  	EQU 0D5B9H
OUTCRLF 	EQU 0D5C9H
PRTMESG 	EQU 0D5D3H
RDBUFF  	EQU 0D5E1H
RDBUF1  	EQU 0D5EFH
RDBUF2  	EQU 0D5F1H
RDBUF3  	EQU 0D616H
RDBUF4  	EQU 0D626H
RDBUF5  	EQU 0D637H
RDBUF6  	EQU 0D648H
RDBUF7  	EQU 0D64EH
RDBUF8  	EQU 0D65FH
RDBUF9  	EQU 0D66BH
RDBUF10 	EQU 0D670H
RDBUF11 	EQU 0D678H
RDBUF12 	EQU 0D68AH
RDBUF13 	EQU 0D699H
RDBUF14 	EQU 0D6A6H
RDBUF15 	EQU 0D6A9H
RDBUF16 	EQU 0D6BDH
RDBUF17 	EQU 0D6C1H
GETCON  	EQU 0D6C8H
GETRDR  	EQU 0D6CEH
DIRCIO  	EQU 0D6D4H
DIRC1   	EQU 0D6E0H
GETIOB  	EQU 0D6EDH
SETIOB  	EQU 0D6F3H
PRTSTR  	EQU 0D6F8H
GETCSTS 	EQU 0D6FEH
SETSTAT 	EQU 0D701H
RTN     	EQU 0D704H
IOERR1  	EQU 0D705H
OUTFLAG 	EQU 0D70AH
STARTING	EQU 0D70BH
CURPOS  	EQU 0D70CH
PRTFLAG 	EQU 0D70DH
CHARBUF 	EQU 0D70EH
USRSTACK	EQU 0D70FH
STKAREA 	EQU 0D741H
USERNO  	EQU 0D741H
ACTIVE  	EQU 0D742H
PARAMS  	EQU 0D743H
STATUS  	EQU 0D745H
SLCTERR 	EQU 0D747H
JUMPHL  	EQU 0D74AH
DE2HL   	EQU 0D74FH
DE2HL1  	EQU 0D750H
SELECT  	EQU 0D759H
SELECT1 	EQU 0D79DH
HOMEDRV 	EQU 0D7A1H
DOREAD  	EQU 0D7B2H
DOWRITE 	EQU 0D7B8H
IORET   	EQU 0D7BBH
TRKSEC  	EQU 0D7C3H
TRKSEC1 	EQU 0D7D1H
TRKSEC2 	EQU 0D7E4H
TRKSEC3 	EQU 0D7FAH
TRKSEC4 	EQU 0D80FH
GETBLOCK	EQU 0D83EH
GETBLK1 	EQU 0D845H
GETBLK2 	EQU 0D853H
GETBLK3 	EQU 0D85CH
EXTBLK  	EQU 0D85EH
EXTBLK1 	EQU 0D871H
COMBLK  	EQU 0D877H
CHKBLK  	EQU 0D884H
LOGICAL 	EQU 0D88AH
LOGICL1 	EQU 0D890H
SETEXT  	EQU 0D8A6H
SETHLDE 	EQU 0D8AEH
STRDATA 	EQU 0D8BBH
SETNREC 	EQU 0D8D2H
STNREC1 	EQU 0D8DEH
SHIFTR  	EQU 0D8EAH
SHIFTR1 	EQU 0D8EBH
CHECKSUM	EQU 0D8F7H
CHKSUM1 	EQU 0D8FDH
SHIFTL  	EQU 0D904H
SHIFTL1 	EQU 0D905H
SETBIT  	EQU 0D90BH
GETWPRT 	EQU 0D91EH
WRTPRTD 	EQU 0D92CH
CHKROFL 	EQU 0D944H
CKROF1  	EQU 0D947H
CHKWPRT 	EQU 0D954H
FCB2HL  	EQU 0D95EH
ADDA2HL 	EQU 0D964H
GETS2   	EQU 0D969H
CLEARS2 	EQU 0D972H
SETS2B7 	EQU 0D978H
MOREFLS 	EQU 0D97FH
CHKNMBR 	EQU 0D98CH
SUBHL   	EQU 0D995H
SETDIR  	EQU 0D99CH
CHECKDIR	EQU 0D99EH
CHKDIR1 	EQU 0D9C4H
DIRWRITE	EQU 0D9C6H
DIRREAD 	EQU 0D9D4H
DEFDMA  	EQU 0D9DAH
DIRDMA  	EQU 0D9E0H
DIRDMA1 	EQU 0D9E3H
MOVEDIR 	EQU 0D9E9H
CKFILPOS	EQU 0D9F5H
STFILPOS	EQU 0D9FEH
NXENTRY 	EQU 0DA05H
NXENT1  	EQU 0DA19H
NXENT2  	EQU 0DA20H
CKBITMAP	EQU 0DA35H
CKBMAP1 	EQU 0DA56H
STBITMAP	EQU 0DA5CH
STBMAP1 	EQU 0DA64H
SETFILE 	EQU 0DA6BH
SETFL1  	EQU 0DA75H
SETFL2  	EQU 0DA88H
SETFL3  	EQU 0DA8EH
SETFL4  	EQU 0DA9DH
BITMAP  	EQU 0DAA3H
BITMAP1 	EQU 0DAB1H
BITMAP2 	EQU 0DAD2H
BITMAP3 	EQU 0DAF6H
STSTATUS	EQU 0DB01H
SAMEXT  	EQU 0DB07H
FINDFST 	EQU 0DB18H
FINDNXT 	EQU 0DB2DH
FNDNXT1 	EQU 0DB4AH
FNDNXT2 	EQU 0DB53H
FNDNXT3 	EQU 0DB73H
FNDNXT4 	EQU 0DB7CH
FNDNXT5 	EQU 0DB83H
FNDNXT6 	EQU 0DB94H
ERAFILE 	EQU 0DB9CH
ERAFIL1 	EQU 0DBA4H
FNDSPACE	EQU 0DBBEH
FNDSPA1 	EQU 0DBC0H
FNDSPA2 	EQU 0DBD1H
FNDSPA3 	EQU 0DBECH
FNDSPA4 	EQU 0DBF4H
FCBSET  	EQU 0DBFDH
UPDATE  	EQU 0DC01H
UPDATE1 	EQU 0DC10H
CHGNAMES	EQU 0DC16H
CHGNAM1 	EQU 0DC27H
SAVEATTR	EQU 0DC3BH
SAVATR1 	EQU 0DC40H
OPENIT  	EQU 0DC51H
OPENIT1 	EQU 0DC5AH
OPENIT2 	EQU 0DC8BH
MOVEWORD	EQU 0DC94H
CLOSEIT 	EQU 0DCA2H
CLOSEIT1	EQU 0DCCDH
CLOSEIT2	EQU 0DCDBH
CLOSEIT3	EQU 0DCE1H
CLOSEIT4	EQU 0DCE8H
CLOSEIT5	EQU 0DCFDH
CLOSEIT6	EQU 0DD17H
CLOSEIT7	EQU 0DD1FH
GETEMPTY	EQU 0DD24H
GETMT1  	EQU 0DD46H
GETNEXT 	EQU 0DD5AH
GTNEXT1 	EQU 0DD83H
GTNEXT2 	EQU 0DD8EH
GTNEXT3 	EQU 0DDACH
GTNEXT4 	EQU 0DDAFH
GTNEXT5 	EQU 0DDB6H
RDSEQ   	EQU 0DDBCH
RDSEQ1  	EQU 0DDC1H
RDSEQ2  	EQU 0DDE6H
RDSEQ3  	EQU 0DDFBH
WTSEQ   	EQU 0DDFEH
WTSEQ1  	EQU 0DE03H
WTSEQ2  	EQU 0DE3BH
WTSEQ3  	EQU 0DE48H
WTSEQ4  	EQU 0DE64H
WTSEQ5  	EQU 0DE6CH
WTSEQ6  	EQU 0DE6EH
WTSEQ7  	EQU 0DE8CH
WTSEQ8  	EQU 0DE9AH
WTSEQ9  	EQU 0DEBBH
WTSEQ10 	EQU 0DED2H
WTSEQ99 	EQU 0DEDFH
WTSEQ11 	EQU 0DEFEH
WTSEQ12 	EQU 0DF00H
POSITION	EQU 0DF03H
POSITN1 	EQU 0DF07H
POSITN2 	EQU 0DF47H
POSITN3 	EQU 0DF7FH
POSITN4 	EQU 0DF84H
POSITN5 	EQU 0DF8BH
READRAN 	EQU 0DF93H
WRITERAN	EQU 0DF9CH
COMPRAND	EQU 0DFA5H
RANSIZE 	EQU 0DFD2H
RANSIZ1 	EQU 0DFE4H
RANSIZ2 	EQU 0E006H
RANSIZ3 	EQU 0E00CH
SETRAN  	EQU 0E00EH
LOGINDRV	EQU 0E021H
SETDSK  	EQU 0E045H
AUTOSEL 	EQU 0E051H
AUTOSL1 	EQU 0E075H
GETVER  	EQU 0E07EH
RSTDSK  	EQU 0E083H
OPENFIL 	EQU 0E09CH
CLOSEFIL	EQU 0E0A5H
GETFST  	EQU 0E0ABH
GETFST1 	EQU 0E0C2H
GETNXT  	EQU 0E0C8H
DELFILE 	EQU 0E0D7H
READSEQ 	EQU 0E0E0H
WRTSEQ  	EQU 0E0E6H
FCREATE 	EQU 0E0ECH
RENFILE 	EQU 0E0F5H
GETLOG  	EQU 0E0FEH
GETCRNT 	EQU 0E104H
PUTDMA  	EQU 0E10AH
GETALOC 	EQU 0E111H
GETROV  	EQU 0E117H
SETATTR 	EQU 0E11DH
GETPARM 	EQU 0E126H
GETPRM1 	EQU 0E129H
GETUSER 	EQU 0E12DH
SETUSER 	EQU 0E13BH
RDRANDOM	EQU 0E141H
WTRANDOM	EQU 0E147H
FILESIZE	EQU 0E14DH
LOGOFF  	EQU 0E153H
GOBACK  	EQU 0E174H
GOBACK1 	EQU 0E191H
WTSPECL 	EQU 0E19BH
EMPTYFCB	EQU 0E1ACH
WRTPRT  	EQU 0E1ADH
LOGIN   	EQU 0E1AFH
USERDMA 	EQU 0E1B1H
SCRATCH1	EQU 0E1B3H
SCRATCH2	EQU 0E1B5H
SCRATCH3	EQU 0E1B7H
DIRBUF  	EQU 0E1B9H
DISKPB  	EQU 0E1BBH
CHKVECT 	EQU 0E1BDH
ALOCVECT	EQU 0E1BFH
SECTORS 	EQU 0E1C1H
BLKSHFT 	EQU 0E1C3H
BLKMASK 	EQU 0E1C4H
EXTMASK 	EQU 0E1C5H
DSKSIZE 	EQU 0E1C6H
DIRSIZE 	EQU 0E1C8H
ALLOC0  	EQU 0E1CAH
ALLOC1  	EQU 0E1CCH
OFFSET  	EQU 0E1CEH
XLATE   	EQU 0E1D0H
CLOSEFLG	EQU 0E1D2H
RDWRTFLG	EQU 0E1D3H
FNDSTAT 	EQU 0E1D4H
MODE    	EQU 0E1D5H
EPARAM  	EQU 0E1D6H
RELBLOCK	EQU 0E1D7H
COUNTER 	EQU 0E1D8H
SAVEFCB 	EQU 0E1D9H
BIGDISK 	EQU 0E1DDH
AUTO    	EQU 0E1DEH
OLDDRV  	EQU 0E1DFH
AUTOFLAG	EQU 0E1E0H
SAVNXT  	EQU 0E1E1H
SAVEXT  	EQU 0E1E2H
SAVNREC 	EQU 0E1E3H
BLKNMBR 	EQU 0E1E5H
LOGSECT 	EQU 0E1E7H
FCBPOS  	EQU 0E1E9H
FILEPOS 	EQU 0E1EAH
CKSUMTBL	EQU 0E1ECH
BOOT    	EQU 0E200H
WBOOT   	EQU 0E203H
CONST   	EQU 0E206H
CONIN   	EQU 0E209H
CONOUT  	EQU 0E20CH
LIST    	EQU 0E20FH
PUNCH   	EQU 0E212H
READER  	EQU 0E215H
HOME    	EQU 0E218H
SELDSK  	EQU 0E21BH
SETTRK  	EQU 0E21EH
SETSEC  	EQU 0E221H
SETDMA  	EQU 0E224H
READ    	EQU 0E227H
WRITE   	EQU 0E22AH
PRSTAT  	EQU 0E22DH
SECTRN  	EQU 0E230H
